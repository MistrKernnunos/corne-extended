## Kconfig.defconfig
```kconfig
if SHIELD_CORNE_EXTENDED_LEFT

config ZMK_KEYBOARD_NAME
  default "Corne extended"

config ZMK_SPLIT_ROLE_CENTRAL
  default y

endif

if SHIELD_CORNE_EXTENDED_RIGHT || SHIELD_CORNE_EXTENDED_LEFT

config ZMK_SPLIT
  default y

endif
```

## Kconfig.shield
```kconfig
config SHIELD_CORNE_EXTENDED_LEFT
  def_bool $(shields_list_contains,corne-extended_left)

config SHIELD_CORNE_EXTENDED_RIGHT
  def_bool $(shields_list_contains,corne-extended_right)
```
